## configs/mt7621_nor_template_defconfig
```kconfig
# --- 基础架构 ---
CONFIG_MIPS=y
CONFIG_MACH_MT7621=y
CONFIG_BOARD_MT7621_NOR_TEMPLATE=y

# --- 核心修复：解决编译报错 (必须手动开启) ---
CONFIG_CRC16=y
CONFIG_SPL_CRC16=y

# --- 功能瘦身：彻底移除 WEB 界面 ---
# CONFIG_WEBUI_FAILSAFE is not set
# CONFIG_WEBUI_FAILSAFE_ON_AUTOBOOT_FAIL is not set

# --- 功能瘦身：彻底移除 Ymodem (串口传文件) ---
# CONFIG_SPL_YMODEM_SUPPORT is not set
# CONFIG_CMD_YMODEM is not set

# --- 驱动瘦身：只保留最常用的 Flash 品牌 (大幅减小体积) ---
CONFIG_SPI_FLASH=y
CONFIG_SPI_FLASH_WINBOND=y
CONFIG_SPI_FLASH_MACRONIX=y
CONFIG_SPI_FLASH_GIGADEVICE=y
# 其他如 EON, ISSI, SPANSION 等全部不要开启

# --- 移除文件系统支持 (TFTP 引导不需要挂载分区) ---
# CONFIG_PARTITIONS is not set
# CONFIG_FS_FAT is not set
# CONFIG_FS_EXT4 is not set
# CONFIG_CMD_FAT is not set
# CONFIG_CMD_EXT4 is not set

# --- 移除不必要的命令 ---
# CONFIG_CMD_BOOTMENU is not set
# CONFIG_CMD_GPIO is not set
# CONFIG_CMD_LOADB is not set

# --- 网络与引导 (必须保留以支持 TFTP) ---
CONFIG_NET=y
CONFIG_CMD_NET=y
CONFIG_CMD_TFTPBOOT=y
CONFIG_DM_ETH=y
CONFIG_MT7621_ETH=y
CONFIG_LZMA=y
CONFIG_SPL_LZMA=y

# --- 自动化配置 ---
CONFIG_BOOTDELAY=0
CONFIG_MTKAUTOBOOT_DELAY=1
CONFIG_USE_BOOTCOMMAND=y
CONFIG_BOOTCOMMAND="mtkautoboot"
```
